## sdkconfig.defaults
```kconfig
CONFIG_IDF_TARGET="esp32s2"
CONFIG_ESP_CONSOLE_NONE=y
CONFIG_TINYUSB=y
CONFIG_TINYUSB_NET_ENABLED=y
CONFIG_FREERTOS_HZ=1000
CONFIG_BOOTLOADER_APP_ROLLBACK_ENABLE=y
CONFIG_PARTITION_TABLE_TWO_OTA=y
CONFIG_ESPTOOLPY_FLASHSIZE_4MB=y
CONFIG_ESP_TASK_WDT_PANIC=y
CONFIG_ESP_TASK_WDT_TIMEOUT_S=6
CONFIG_IO4EDGE_CDC_ECM=y
CONFIG_FREERTOS_MAX_TASK_NAME_LEN=64
CONFIG_LWIP_MAX_LISTENING_TCP=16
CONFIG_LWIP_MAX_SOCKETS=16
CONFIG_COMPILER_OPTIMIZATION_PERF=y
CONFIG_ESPTOOLPY_FLASHMODE_QIO=y
CONFIG_IO4EDGE_HW_INV_FLASH=y
CONFIG_TWAI_ISR_IN_IRAM=y
CONFIG_TWAI_ERRATA_FIX_TX_INTR_LOST=y
CONFIG_TWAI_ERRATA_FIX_RX_FRAME_INVALID=y
CONFIG_TWAI_ERRATA_FIX_RX_FIFO_CORRUPT=y
CONFIG_TWAI_ERRATA_FIX_BUS_OFF_REC=y
CONFIG_FUNCTIONBLOCK_MAX_CMD_MSG_SIZE=2048
CONFIG_FUNCTIONBLOCK_MAX_DESERIAL_MSG_SIZE=2048
CONFIG_FUNCTIONBLOCK_MAX_DESERIAL_FUNCSPEC_MSG_SIZE=2048
CONFIG_FREERTOS_USE_TRACE_FACILITY=y
CONFIG_FREERTOS_USE_STATS_FORMATTING_FUNCTIONS=y
```
